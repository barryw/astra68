## esp32/astrahost/sdkconfig.defaults
```kconfig
CONFIG_IDF_TARGET="esp32"
CONFIG_FREERTOS_HZ=1000
CONFIG_FATFS_LFN_HEAP=y
CONFIG_FATFS_MAX_LFN=255
CONFIG_FATFS_API_ENCODING_UTF_8=y
CONFIG_FATFS_PER_FILE_CACHE=y
CONFIG_ESP_CONSOLE_UART_DEFAULT=y
CONFIG_ESP_CONSOLE_UART_BAUDRATE=115200
CONFIG_COMPILER_OPTIMIZATION_SIZE=y
CONFIG_ESPTOOLPY_FLASHSIZE_4MB=y
CONFIG_PARTITION_TABLE_TWO_OTA=y
```

## fpga/de25/boot.its
```
/dts-v1/;

/ {
    description = "FIT image for Astra 68 U-Boot script";
    #address-cells = <1>;

    images {
        default = "script";

        script {
            description = "Astra 68 U-Boot script";
            data = /incbin/("boot.cmd");
            type = "script";
            compression = "none";

            hash {
                algo = "crc32";
            };
        };
    };
};
```
